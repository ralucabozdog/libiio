## west.yml
```yaml
# Copyright (c) 2026 Analog Devices, Inc.
# SPDX-License-Identifier: MIT

manifest:
  remotes:
    - name: zephyrproject-rtos
      url-base: https://github.com/zephyrproject-rtos

  projects:
    - name: zephyr
      remote: zephyrproject-rtos
      revision: c199f92c7e4bba820573d6be9ba0c75385601b67
      clone-depth: 1
      import:
        name-allowlist:
          - cmsis_6
          - hal_adi
          - hal_nordic
          - hal_nxp
          - hal_rpi_pico
          - hal_stm32
          - hal_st
          - net-tools
          - picolibc
```

## zephyr/Kconfig
```kconfig
# Copyright (c) 2025 Analog Devices, Inc.
# SPDX-License-Identifier: MIT

menuconfig LIBIIO
	bool "libiio support"
	depends on POSIX_API
	help
	  This option enables the libiio library.

if LIBIIO

module = LIBIIO
module-str = libiio
source "subsys/logging/Kconfig.template.log_config"

config LIBIIO_LOG_MSG_SIZE
	int "Maximum length of a single libiio log message (bytes)"
	default 128
	help
	  Each call to zephyr iio_prm_printf() formats the message into a stack-
	  allocated buffer of this size before handing it to the Zephyr
	  logging subsystem. Increase this value if libiio log messages are
	  being truncated.

config LIBIIO_IIOD_V0_COMPAT
	bool "libiio v0.x (ASCII protocol) compatibility"
	default y
	help
	  Make the iiod server understand the line-based ASCII command
	  protocol used by libiio v0.x clients, in addition to the binary
	  protocol used by v1.x clients. The client is detected automatically:
	  a v1 client's first command is "BINARY", which switches the server
	  to the binary protocol; a v0 client stays on the ASCII protocol.

	  Disable this to build a binary-only (v1) server.

rsource "drivers/Kconfig"
rsource "iiod/Kconfig"

endif # LIBIIO
```

## zephyr/drivers/adc/Kconfig
```kconfig
# Copyright (c) 2025 Analog Devices, Inc.
# SPDX-License-Identifier: MIT

if ADC

menu "ADC"

config ADC_EMUL_GENERATOR
	bool "ADC emulator generator"
	default y
	depends on DT_HAS_IIO_ADC_EMUL_GENERATOR_ENABLED && ADC_EMUL

config LIBIIO_AD463X_IIO_PROVIDER
	bool "AD463x bulk-capture IIO provider"
	default y
	depends on ADC_AD463X
	help
	  Register the AD463x driver's ad463x_read_buffer() into the libiio
	  bulk-capture iterable section so io_channels can use DMA capture
	  instead of the per-sample ADC API shim.

endmenu

endif # ADC
```

## zephyr/drivers/iio_device/Kconfig
```kconfig
# Copyright (c) 2025 Analog Devices, Inc.
# SPDX-License-Identifier: MIT

menuconfig LIBIIO_IIO_DEVICE
	bool "IIO device drivers"
	default y
	help
	  Enable IIO device drivers

if LIBIIO_IIO_DEVICE

config LIBIIO_IIO_DEVICE_FP
	bool "Support full floating-point operation"
	select REQUIRES_FULL_LIBC
	help
	  Enable full floating point support, for inputs/outputs

config LIBIIO_IIO_DEVICE_ADC
	bool "ADC IIO device driver"
	default y
	depends on DT_HAS_IIO_ADC_ENABLED && ADC
	help
	  Enable the IIO ADC device driver.

config LIBIIO_IIO_DEVICE_ADC_INIT_PRIORITY
	int "ADC IIO device driver init priority"
	default 50
	depends on LIBIIO_IIO_DEVICE_ADC
	help
	  Initialization priority of the IIO ADC device driver.

config LIBIIO_IIO_DEVICE_IO_CHANNELS
	bool "ADC/DAC IO channels driver"
	default y
	depends on DT_HAS_IIO_IO_CHANNELS_ENABLED && (ADC || DAC)
	help
	  Enable the Zephyr ADC/DAC io channels iio device driver class.

config LIBIIO_IIO_DEVICE_IO_CHANNELS_INIT_PRIORITY
	int "ADC driver init priority"
	default KERNEL_INIT_PRIORITY_DEVICE
	depends on LIBIIO_IIO_DEVICE_IO_CHANNELS
	help
	  Initialization priority of the Zephyr ADC/DAC io-channels iio device driver class.

config LIBIIO_IIO_DEVICE_SENSOR
	bool "Sensor driver"
	default y
	depends on DT_HAS_IIO_SENSOR_ENABLED && SENSOR
	help
	  Enable the Zephyr Sensor iio device driver class.

config LIBIIO_IIO_DEVICE_SENSOR_INIT_PRIORITY
	int "Sensor driver init priority"
	default 90
	depends on LIBIIO_IIO_DEVICE_SENSOR
	help
	  Initialization priority of the Zephyr Sensor iio device driver class.
	  Has to be higher than the initialization priority of the sensor drivers.

config LIBIIO_IIO_DEVICE_TRIGGER_INIT_PRIORITY
	int "Trigger driver init priority"
	default KERNEL_INIT_PRIORITY_DEVICE
	help
	  Initialization priority of the Zephyr Trigger iio device driver class.
	  Has to be same or higher than the initialization priority of the io-channel iio
	  device drivers.

endif # LIBIIO_IIO_DEVICE
```

## zephyr/drivers/iio_device/Kconfig.trigger_io_channels_stream
```kconfig
# Copyright (c) 2026 Analog Devices, Inc.
# SPDX-License-Identifier: MIT

if DT_HAS_IIO_TRIGGER_IO_CHANNELS_STREAM_ENABLED

config LIBIIO_IIO_DEVICE_TRIGGER_IO_CHANNELS_STREAM_INIT_PRIORITY
	int "Trigger driver init priority"
	default 100
	help
	  Initialization priority of the Trigger I/O Channels Stream iio device driver class.
	  Has to be same or higher than the initialization priority of the io_channels 
	  iio device drivers.

config LIBIIO_IIO_DEVICE_TRIGGER_IO_CHANNELS_STREAM_THREAD_STACK_SIZE
	int "Stream trigger thread stack size"
	default 2048
	help
	  Stack size of thread used by the trigger io_channels stream driver to handle reading from RTIO.

config LIBIIO_IIO_DEVICE_TRIGGER_IO_CHANNELS_STREAM_THREAD_PRIORITY
	int "Thread priority"
	default 15
	help
	  Priority of thread used by the trigger io_channels stream driver to handle reading from RTIO.

config LIBIIO_IIO_DEVICE_TRIGGER_IO_CHANNELS_STREAM_SQ_SZ
	int "Size of the submission queue"
	default 16
	help
	  Size of the submission queue, must be power of 2.

config LIBIIO_IIO_DEVICE_TRIGGER_IO_CHANNELS_STREAM_CQ_SZ
	int "Size of the completion queue"
	default 16
	help
	  Size of the completion queue, must be power of 2.

config LIBIIO_IIO_DEVICE_TRIGGER_IO_CHANNELS_STREAM_NUM_BLKS
	int "Number of blocks"
	default 200
	help
	  Number of blocks in the RTIO memory pool.

config LIBIIO_IIO_DEVICE_TRIGGER_IO_CHANNELS_STREAM_BLK_SIZE
	int "The number of bytes in each block"
	default 256
	help
	  The number of bytes in each block.

endif # DT_HAS_IIO_TRIGGER_IO_CHANNELS_STREAM_ENABLED
```

## zephyr/drivers/iio_device/Kconfig.trigger_sensor_stream
```kconfig
# Copyright (c) 2026 Analog Devices, Inc.
# SPDX-License-Identifier: MIT

if DT_HAS_IIO_TRIGGER_SENSOR_STREAM_ENABLED

config LIBIIO_IIO_DEVICE_TRIGGER_SENSOR_STREAM_INIT_PRIORITY
	int "Trigger driver init priority"
	default 100
	help
	  Initialization priority of the Trigger Sensor Stream iio device driver class.
	  Has to be same or higher than the initialization priority of the sensor 
	  iio device drivers.

config LIBIIO_IIO_DEVICE_TRIGGER_SENSOR_STREAM_THREAD_STACK_SIZE
	int "Stream trigger thread stack size"
	default 2048
	help
	  Stack size of thread used by the trigger sensor stream driver to handle reading from RTIO.

config LIBIIO_IIO_DEVICE_TRIGGER_SENSOR_STREAM_THREAD_PRIORITY
	int "Thread priority"
	default 15
	help
	  Priority of thread used by the trigger sensor stream driver to handle reading from RTIO.

config LIBIIO_IIO_DEVICE_TRIGGER_SENSOR_STREAM_SQ_SZ
	int "Size of the submission queue"
	default 16
	help
	  Size of the submission queue, must be power of 2.

config LIBIIO_IIO_DEVICE_TRIGGER_SENSOR_STREAM_CQ_SZ
	int "Size of the completion queue"
	default 16
	help
	  Size of the completion queue, must be power of 2.

config LIBIIO_IIO_DEVICE_TRIGGER_SENSOR_STREAM_NUM_BLKS
	int "Number of blocks"
	default 200
	help
	  Number of blocks in the RTIO memory pool.

config LIBIIO_IIO_DEVICE_TRIGGER_SENSOR_STREAM_BLK_SIZE
	int "The number of bytes in each block"
	default 256
	help
	  The number of bytes in each block.

endif # DT_HAS_IIO_TRIGGER_SENSOR_STREAM_ENABLED
```

## zephyr/dts/bindings/iio/iio,adc.yaml
```yaml
# Copyright (c) 2025 Analog Devices, Inc.
# SPDX-License-Identifier: MIT

include: base.yaml

description: IIO ADC device

compatible: "iio,adc"

properties:
  io-channels:
    required: true
  io-channel-names:
    required: true
  reg:
    required: true
  io-name:
    type: string
    description: |
      The device name for use within IIOD. If not set, the device's node will be used
      as a fallback.
  buffer-name:
    type: string
    description: |
      Name of the buffer attribute for this IIO device.
      If not specified, defaults to "buffer".
```

## zephyr/dts/bindings/iio/iio,io-channels.yaml
```yaml
# Copyright (c) 2025 Analog Devices, Inc.
# SPDX-License-Identifier: MIT

include: iio,iio-device.yaml

description: IIO ADC/DAC io-channels

compatible: "iio,io-channels"

properties:
  io-channels:
    required: true
  io-channel-names:
    required: true
  buffer-name:
    type: string
    description: |
      Name of the buffer attribute for this IIO device.
      If not specified, defaults to "buffer".
  trigger-device:
    type: phandle
    description: |
      Phandle to the IIO trigger device node that this device is associated with.
```

## zephyr/dts/bindings/iio/iio,sensor.yaml
```yaml
# Copyright (c) 2025 Analog Devices, Inc.
# SPDX-License-Identifier: MIT

include: iio,iio-device.yaml

description: IIO sensor

compatible: "iio,sensor"

properties:
  sensor-device:
    type: phandle
    required: true

  sensor-channels:
    type: array
    required: true

  buffer-name:
    type: string
    description: |
      Name of the buffer attribute for this IIO device.
      If not specified, defaults to "buffer".

  trigger-device:
    type: phandle
    description: |
      Phandle to the IIO trigger device node that this device is associated with. It is used for
      trigger-timer devices. For trigger-sensor and trigger-sensor-stream devices, the trigger node must be 
      nested inside the sensor node.

child-binding:
  description: |
    Trigger node nested inside the IIO sensor node. Must use a compatible
    iio,trigger-sensor or iio,trigger-sensor-stream.
    The trigger child node is identified at build time by the presence of the
    'trigger-id' property and may have any node name (e.g. trigger, trigger0,
    trigger_sensor0).
    When this child node is present, the 'trigger-device' property of the parent
    sensor node must not be specified.
```

## zephyr/dts/bindings/iio/iio,trigger.yaml
```yaml
# Copyright (c) 2026 Analog Devices, Inc.
# SPDX-License-Identifier: MIT

include: base.yaml

description: IIO trigger binding

properties:
  io-name:
    required: true
    type: string
    description: |
      The device name for use within IIOD. Can be one of the predefined names:
      "trigger_timer", "trigger_sensor", "trigger_sensor_stream" or "trigger_io_channels_stream"
      followed by a unique identifier ("0", "1", etc.).
      Example: "trigger_timer0", "trigger_sensor1", "trigger_sensor_stream2", "trigger_io_channels_stream3".

  trigger-id:
    required: true
    type: string
    description: |
      ID of the trigger. Must start with "trigger".
```

## zephyr/dts/bindings/iio/iio,trigger_io_channels_stream.yaml
```yaml
# Copyright (c) 2026 Analog Devices, Inc.
# SPDX-License-Identifier: MIT

include: iio,trigger.yaml

description: IIO I/O channels stream trigger binding

compatible: "iio,trigger-io-channels-stream"
```

## zephyr/dts/bindings/iio/iio,trigger_sensor.yaml
```yaml
# Copyright (c) 2026 Analog Devices, Inc.
# SPDX-License-Identifier: MIT

include: iio,trigger.yaml

description: IIO sensor trigger binding

compatible: "iio,trigger-sensor"
```

## zephyr/dts/bindings/iio/iio,trigger_sensor_stream.yaml
```yaml
# Copyright (c) 2026 Analog Devices, Inc.
# SPDX-License-Identifier: MIT

include: iio,trigger.yaml

description: IIO sensor stream trigger binding

compatible: "iio,trigger-sensor-stream"

properties:
  sensor-stream-channels:
    type: array
    required: true
    description: |
      Array of sensor channel identifiers specifying which channels to include
      in the RTIO sensor stream. Use the IIO_SENSOR_CHAN_* constants defined in
      <dt-bindings/iio/sensor-channels.h> (e.g. IIO_SENSOR_CHAN_ACCEL_X,
      IIO_SENSOR_CHAN_ACCEL_Y, IIO_SENSOR_CHAN_ACCEL_Z).
```

## zephyr/dts/bindings/iio/iio,trigger_timer.yaml
```yaml
# Copyright (c) 2026 Analog Devices, Inc.
# SPDX-License-Identifier: MIT

include: iio,trigger.yaml

description: IIO timer trigger binding

compatible: "iio,trigger-timer"
```

## zephyr/dts/bindings/iio/iio,trigger_zephyr_common.yaml
```yaml
# Copyright (c) 2026 Analog Devices, Inc.
# SPDX-License-Identifier: MIT

include: iio,trigger.yaml

description: IIO zephyr trigger binding

compatible: "iio,trigger-zephyr-common"
```
