## zephyr/iiod/Kconfig
```kconfig
# Copyright (c) 2025 Analog Devices, Inc.
# SPDX-License-Identifier: MIT

menuconfig LIBIIO_IIOD_NETWORK
	bool "Network iiod server"
	help
	  Enable the iiod server over a network interface.

if LIBIIO_IIOD_NETWORK

config LIBIIO_IIOD_NETWORK_PORT
	int "Port number"
	default 30431
	help
	  Port number

config LIBIIO_IIOD_NETWORK_SERVER_THREAD_PRIORITY
	int "Server thread priority"
	default 10
	help
	  Priority of the thread running the iiod server.

config LIBIIO_IIOD_NETWORK_SERVER_THREAD_STACK_SIZE
	int "Server thread stack size"
	default 4096
	help
	  Stack size of the thread running the iiod server.

config LIBIIO_IIOD_NETWORK_CLIENT_THREAD_PRIORITY
	int "Client thread priority"
	default 5
	help
	  Priority of the thread running the network client.

config LIBIIO_IIOD_NETWORK_CLIENT_THREAD_STACK_SIZE
	int "Client thread stack size"
	default 8192
	help
	  Stack size of the thread running the network client.

config LIBIIO_IIOD_NETWORK_CLIENT_MAX
	int "Maximum number of clients"
	default 6
	help
	  Maximum number of network clients.

endif # LIBIIO_IIOD_NETWORK

menuconfig LIBIIO_IIOD_USB
	bool "USB iiod server"
	help
	  Enable the iiod server over a USB interface.

if LIBIIO_IIOD_USB

config LIBIIO_IIOD_USB_THREAD_PRIORITY
	int "Thread priority"
	default 10
	help
	  Priority of the thread running the iiod server.

config LIBIIO_IIOD_USB_THREAD_STACK_SIZE
	int "Thread stack size"
	default 4096
	help
	  Stack size of the thread running the iiod server.

config LIBIIO_IIOD_USB_RX_BUF_SIZE
	int "RX buffer size"
	default 2048
	help
	  Size of the ring buffer for storing data received from the USB
	  device before it can be processed by the iiod server.

config LIBIIO_IIOD_USB_TX_BUF_SIZE
	int "TX buffer size"
	default 16
	help
	  Size of the ring buffer for storing data written by the iiod server
	  before it can be transmitted by the USB device.

config LIBIIO_IIOD_USB_NUM_PIPES
	int "Number of USB pipes"
	default 3
	range 1 6
	help
	  Number of USB bulk endpoint pairs (pipes) to expose.
	  Pipe 0 is used for the IIOD command channel. Additional pipes
	  are used for data streaming (one per concurrent buffer/stream).
	  Each pipe requires one IN and one OUT bulk endpoint.
	  The USB device controller must support enough endpoints.

config LIBIIO_IIOD_USB_PIPE_THREAD_STACK_SIZE
	int "Pipe thread stack size"
	default 8192
	help
	  Stack size of threads running the iiod interpreter on data pipes.

endif # LIBIIO_IIOD_USB

# Source USB device descriptor configuration options
rsource "../snippets/iiod-usb/Kconfig.iiod-usbd"

menuconfig LIBIIO_IIOD_UART
	bool "UART iiod server"
	help
	  Enable the iiod server over a UART interface.

if LIBIIO_IIOD_UART

config LIBIIO_IIOD_UART_THREAD_PRIORITY
	int "Thread priority"
	default 10
	help
	  Priority of the thread running the iiod server.

config LIBIIO_IIOD_UART_THREAD_STACK_SIZE
	int "Thread stack size"
	default 4096
	help
	  Stack size of the thread running the iiod server.

config LIBIIO_IIOD_UART_RX_BUF_SIZE
	int "RX buffer size"
	default 2048
	help
	  Size of the ring buffer for storing data received from the UART
	  device before it can be processed by the iiod server.
	  Currently, set to larger to support rwdev large sample values.

config LIBIIO_IIOD_UART_TX_BUF_SIZE
	int "TX buffer size"
	default 2048
	help
	  Size of the ring buffer for storing data written by the iiod server
	  before it can be transmitted by the UART device.
	  Currently, set to larger to support rwdev large sample values.

endif # LIBIIO_IIOD_UART
```

## zephyr/tests/iiod/boards/frdm_k64f_mk64f12.conf
```kconfig
# Copyright (c) 2026 Analog Devices, Inc.
# SPDX-License-Identifier: MIT

CONFIG_ADC=y
CONFIG_SPI=y
CONFIG_SENSOR=y
CONFIG_FXOS8700_TEMP=y
```
