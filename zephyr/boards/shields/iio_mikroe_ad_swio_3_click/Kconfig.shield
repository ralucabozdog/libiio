## zephyr/boards/shields/iio_mikroe_ad_swio_3_click/Kconfig.shield
```kconfig
# Copyright (c) 2026 Analog Devices, Inc
# SPDX-License-Identifier: MIT

config SHIELD_IIO_MIKROE_AD_SWIO_3_CLICK
	def_bool $(shields_list_contains,iio_mikroe_ad_swio_3_click)
```

## zephyr/boards/shields/iio_mikroe_iso_adc_2_click/Kconfig.shield
```kconfig
# Copyright (c) 2026 Analog Devices, Inc
# SPDX-License-Identifier: MIT

config SHIELD_IIO_MIKROE_ISO_ADC_2_CLICK
	def_bool $(shields_list_contains,iio_mikroe_iso_adc_2_click)
```
