/*
 * Copyright (c) 2026 Analog Devices, Inc
 * SPDX-License-Identifier: MIT
 */

/ {
	iio-context {
		ad74115h {
			compatible = "iio,io-channels";
			io-name = "ad74115h";
			io-channels = <&ad74115h_mikroe_ad_swio_3_click 0>;
			io-channel-names = "voltage0";
		};
	};
};
