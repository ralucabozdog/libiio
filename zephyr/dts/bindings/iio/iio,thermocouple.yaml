## zephyr/dts/bindings/iio/iio,thermocouple.yaml
```yaml
# Copyright (c) 2025 Analog Devices, Inc.
# SPDX-License-Identifier: MIT

include: base.yaml

description: IIO Thermocouple

compatible: "iio,thermocouple"

properties:
  io-name:
    type: string
```

## zephyr/samples/iiod/boards/apard32690_max32690_m4.conf
```kconfig
# Copyright (c) 2025 Analog Devices, Inc.
# SPDX-License-Identifier: MIT

CONFIG_NET_CONFIG_MY_IPV4_ADDR="192.168.97.100"
CONFIG_NET_CONFIG_MY_IPV4_NETMASK="255.255.0.0"
CONFIG_NET_CONFIG_MY_IPV4_GW="192.168.97.1"
```
