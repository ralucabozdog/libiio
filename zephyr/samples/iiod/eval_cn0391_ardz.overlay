/*
 * Copyright (c) 2025 Analog Devices, Inc.
 *
 * SPDX-License-Identifier: MIT
 */

#include <zephyr/dt-bindings/adc/ad7124-adc.h>

/ {
	iio-context {
		#address-cells = <1>;
		#size-cells = <0>;

		cn0391_thermocouple: ad7124-8 {
			compatible = "iio,thermocouple";
			io-channels = <&ad7124_eval_cn0391_ardz 0>, <&ad7124_eval_cn0391_ardz 1>, <&ad7124_eval_cn0391_ardz 2>,
							<&ad7124_eval_cn0391_ardz 3>, <&ad7124_eval_cn0391_ardz 4>, <&ad7124_eval_cn0391_ardz 5>,
							<&ad7124_eval_cn0391_ardz 6>, <&ad7124_eval_cn0391_ardz 7>, <&ad7124_eval_cn0391_ardz 9>;
			io-channel-names = "ad7124_ch0", "ad7124_ch1", "ad7124_ch2",
								"ad7124_ch3", "ad7124_ch4", "ad7124_ch5",
								"ad7124_ch6", "ad7124_ch7", "ad7124_ch9";
			io-name = "thermocouple";
		};
	};
};
